#include "tof.h"

Tof_SendDataTypeDef Tof_SendData;
Tof_ReceiveDataTypeDef Tof_ReceiveData;

uint8_t Tof_SendData_Buffer[TOF_FRAME_SIZE];  // 用于DMA发送的缓冲区

uint8_t tof_rx_buf[2][2*TOF_RECEIVE_FRAME_SIZE];  // 双缓冲区，用于DMA接收

void TOF_BaudRate_Init(void)
{
  // 初始化TOF配置
  Tof_SendData.deviceAddr = TOF_DEVICE_ADDR;  // 默认从机地址
  Tof_SendData.cmd = TOF_CMD_WRITE;  // 默认写入指令
  Tof_SendData.regAddr_H = TOF_REG_BAUD_RATE >> 8;  //波特率寄存器
  Tof_SendData.regAddr_L = TOF_REG_BAUD_RATE& 0xFFU;  // 
  Tof_SendData.data_H = TOF_BAUD_115200 >> 8;  // 波特率修改为115200bps
  Tof_SendData.data_L = TOF_BAUD_115200& 0xFFU;  // 
  Tof_SendData.crc = crc16_calculate_modbus((uint8_t *)&Tof_SendData, TOF_FRAME_SIZE);  // 计算CRC校验码
  memcpy(Tof_SendData_Buffer, &Tof_SendData, TOF_FRAME_SIZE);
}

void TOF_Reset(void)
{
  // 初始化TOF配置
  Tof_SendData.deviceAddr = TOF_DEVICE_ADDR;  // 默认从机地址
  Tof_SendData.cmd = TOF_CMD_WRITE;  // 默认写入指令
  Tof_SendData.regAddr_H = TOF_REG_SPECIAL >> 8;  //特殊寄存器
  Tof_SendData.regAddr_L = TOF_REG_SPECIAL& 0xFFU;  
  Tof_SendData.data_H = TOF_RESET >> 8;  // 重启设备指令
  Tof_SendData.data_L = TOF_RESET& 0xFFU;  
  Tof_SendData.crc = crc16_calculate_modbus((uint8_t *)&Tof_SendData, TOF_FRAME_SIZE);  // 计算CRC校验码
  memcpy(Tof_SendData_Buffer, &Tof_SendData, TOF_FRAME_SIZE);
}

void TOF_Init(void)
{
    // 1. 使能UART1 DMA接收
    SET_BIT(huart1.Instance->CR3, USART_CR3_DMAR);
    // 使能UART1空闲中断
    __HAL_UART_ENABLE_IT(&huart1, UART_IT_IDLE);

    // 2. 先禁用DMA，确保寄存器可安全配置
    __HAL_DMA_DISABLE(&hdma_usart1_rx);
    while (hdma_usart1_rx.Instance->CR & DMA_SxCR_EN);

    // 3. 配置DMA参数
    hdma_usart1_rx.Instance->PAR = (uint32_t)&(USART1->DR);  // 外设地址：UART1数据寄存器
    hdma_usart1_rx.Instance->M0AR = (uint32_t)tof_rx_buf[0]; // 内存地址0
    hdma_usart1_rx.Instance->M1AR = (uint32_t)tof_rx_buf[1]; // 内存地址1
    hdma_usart1_rx.Instance->NDTR = 2*TOF_RECEIVE_FRAME_SIZE; //          // 传输数据长度
    SET_BIT(hdma_usart1_rx.Instance->CR, DMA_SxCR_DBM);     // 开启双缓冲模式
    // 使能DMA
    __HAL_DMA_ENABLE(&hdma_usart1_rx);

  TOF_BaudRate_Init();
  TOF_Reset();
}

void TOF_Decode(uint8_t *buf, Tof_ReceiveDataTypeDef *Tof_Recieve)
{
  Tof_Recieve->deviceAddr = buf[0];
  Tof_Recieve->cmd = buf[1];
  Tof_Recieve->data_len = buf[2];
  Tof_Recieve->distance = (buf[3] << 8) | buf[4];
  Tof_Recieve->crc = (buf[6] << 8) | buf[5];
	
	LossUpdate(&global_debugger.tof_debugger,0.2f);
}

void TOF_Receive(void)
{
		uint8_t *pBuf = NULL;
    // 1. 检测UART1空闲中断（一帧数据接收完成）
    if(__HAL_UART_GET_FLAG(&huart1, UART_FLAG_IDLE))  
    {
        // 清除空闲中断标志（读取SR和DR寄存器）
        (void)USART1->SR;
        (void)USART1->DR;

        // 2. 判断当前使用的缓冲数组
        if((hdma_usart1_rx.Instance->CR & DMA_SxCR_CT) == RESET)
        {
			pBuf = tof_rx_buf[0];
            hdma_usart1_rx.Instance->CR |= DMA_SxCR_CT;
        }
        else
        {
			pBuf = tof_rx_buf[1];
            hdma_usart1_rx.Instance->CR &= ~(DMA_SxCR_CT);
        }

        // 3. 帧头匹配并解析TOF数据
        for(uint8_t i=0; i<TOF_RECEIVE_FRAME_SIZE-1; i++)
        {
            if(pBuf[i] == TOF_DEVICE_ADDR && pBuf[i+1] == TOF_CMD_READ)
            {
                // 解析TOF数据帧
                TOF_Decode(pBuf+i, &Tof_ReceiveData);
                break;
            }
        }
    }

    // 清除校验位中断标志
    __HAL_UART_CLEAR_PEFLAG(&huart1);
}

/***********************************************************************************************
*函数名: uint16_t crc16_calculate_modbus(uint8_t *ptr, uint16_t len)
*功能描述: modbus crc16校验
*特别说明:
*函数参数:
*函数返回值:
*修改记录:
***********************************************************************************************/
static const uint8_t a_crc16mTableHi[] = {
	0x00, 0xC1, 0x81, 0x40, 0x01, 0xC0, 0x80, 0x41, 0x01, 0xC0, 0x80, 0x41, 0x00, 0xC1, 0x81,
	0x40, 0x01, 0xC0, 0x80, 0x41, 0x00, 0xC1, 0x81, 0x40, 0x00, 0xC1, 0x81, 0x40, 0x01, 0xC0,
	0x80, 0x41, 0x01, 0xC0, 0x80, 0x41, 0x00, 0xC1, 0x81, 0x40, 0x00, 0xC1, 0x81, 0x40, 0x01,
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	0x00, 0xC1, 0x81, 0x40, 0x01, 0xC0, 0x80, 0x41, 0x01, 0xC0, 0x80, 0x41, 0x00, 0xC1, 0x81,
	0x40
};
static const uint8_t a_crc16mTableLo[] = {
	0x00, 0xC0, 0xC1, 0x01, 0xC3, 0x03, 0x02, 0xC2, 0xC6, 0x06, 0x07, 0xC7, 0x05, 0xC5, 0xC4,
	0x04, 0xCC, 0x0C, 0x0D, 0xCD, 0x0F, 0xCF, 0xCE, 0x0E, 0x0A, 0xCA, 0xCB, 0x0B, 0xC9, 0x09,
	0x08, 0xC8, 0xD8, 0x18, 0x19, 0xD9, 0x1B, 0xDB, 0xDA, 0x1A, 0x1E, 0xDE, 0xDF, 0x1F, 0xDD,
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	0x44, 0x84, 0x85, 0x45, 0x87, 0x47, 0x46, 0x86, 0x82, 0x42, 0x43, 0x83, 0x41, 0x81, 0x80,
	0x40
};
uint16_t crc16_calculate_modbus(uint8_t *p_data, uint16_t len)
{
	uint8_t crchi = 0xff;
	uint8_t crclo = 0xff;
	uint16_t index;
  len -= 2;
	while (len--)
	{
		index = crclo ^ *p_data++;
		crclo = crchi ^ a_crc16mTableHi[index];
		crchi = a_crc16mTableLo[index];
	}
	return (crchi << 8 | crclo);
}
